## components/monet_core/Kconfig
```kconfig
# SPDX-License-Identifier: MIT
# monet_core component — optional experimental C++ refactor/demo layer.

menu "Monet Core"

config MONET_CPP_EXPERIMENTAL
    bool "Enable experimental C++ wrappers/refactor layer"
    default n
    help
        Compile the optional C++ demonstration layer that lives under
        components/monet_core/src_cpp and include_cpp. It shows how the
        existing C/FreeRTOS architecture maps to embedded-friendly C++
        (RAII LockGuard, RAII CameraFrame, type-safe Queue<T,N>, a Logger
        backend interface, and a MessageBus class with C API wrappers).

        When this is disabled (the default) the firmware builds and runs
        exactly as the stable pure-C path: no C++ source is compiled and
        there is no flash/RAM cost.

        This layer is intentionally a parallel demo. It does NOT replace
        the production msg_bus.c / service_registry.c paths.

if MONET_CPP_EXPERIMENTAL

choice MONET_CPP_LOGGER_BACKEND
    prompt "C++ Logger backend (build-time selection)"
    default MONET_CPP_LOGGER_BACKEND_UART
    help
        Build-time selection of the default Logger backend returned by
        logger_default_backend(). Runtime polymorphism through the
        LoggerBackend interface is still available; this choice only
        picks which concrete backend is wired up by default so we do not
        pay flash for transports we never select.

config MONET_CPP_LOGGER_BACKEND_UART
    bool "UART console backend"

config MONET_CPP_LOGGER_BACKEND_USB
    bool "USB-CDC backend"

endchoice

config MONET_CPP_DEMO_HANG
    bool "Logger demo: deliberately hang a task (exercises the health monitor)"
    default n
    help
        When enabled, the logger demo's worker task stops checking in after a
        few iterations, simulating a wedged task. The TaskHealthMonitor's
        supervisor then reports it as having missed its deadline.

        Left off by default so normal boots never trip the watchdog. The
        worker is intentionally NOT subscribed to the hardware Task Watchdog,
        so even with this on the chip is not reset — only the soft monitor
        logs the offender. (To see a real TWDT reset, set use_wdt=true when
        registering the worker in logger_demo.cpp.)

endif # MONET_CPP_EXPERIMENTAL

endmenu # Monet Core
```

## components/monet_hal/Kconfig
```kconfig
menu "Monet Hardware Abstraction Layer"

menu "Wi-Fi Station"
config WIFI_SSID
    string "Wi-Fi SSID"
    default "zhenghao的iPhone"
config WIFI_PASSWORD
    string "Wi-Fi password"
    default "12345678"
endmenu

menu "Light Sensor (ADC)"
config LIGHT_SENSOR_CHANNEL
    int "ADC channel for light sensor"
    range 0 9
    default 2
endmenu

menu "UART (debug / data)"

config UART_PORT_NUM
    int "UART port number"
    range 0 2
    default 1
    help
        0 = UART0 (console), 1 = UART1, 2 = UART2 (ESP32-S3 has 3 controllers)

config UART_TX_PIN
    int "UART TX GPIO number"
    range 0 48
    default 47

config UART_RX_PIN
    int "UART RX GPIO number"
    range 0 48
    default 21

config UART_BAUD_RATE
    int "UART baud rate"
    default 921600
    help
        115200 / 921600 are common. 921600 is OK on USB-CDC.

endmenu


endmenu  # HAL
```

## components/net/Kconfig
```kconfig
menu "Networking"

config HTTPS_SERVER_URL
    string "HTTPS server URL"
    default "https://40.233.83.32:8443/data"

config HTTPS_CA_CERT_PEM
    string "PEM CA certificate (paste as literal)"
    default ""

config HTTPS_SKIP_COMMON_NAME_CHECK
    bool "Skip Common-Name check"
    default y

config HTTPS_USE_GLOBAL_CA_STORE
    bool "Use global CA store"
    default n

config HTTP_UPLOADER_SERVICE_ENABLE
    bool "Enable HTTP uploader service"
    default y

endmenu
```

## components/service/Kconfig
```kconfig
menu "Monet Service Modules"

config CAMERA_SERVICE_ENABLE
    bool "Enable camera service"
    default y

config UART_SERVICE_ENABLE
    bool "Enable UART service"
    default y

config BLE_SERVICE_ENABLE
    bool "Enable BLE service"
    default y

config HTTP_UPLOADER_SERVICE_ENABLE
    bool "Enable HTTP uploader service"
    default y

menu "Router (publisher ➜ sink)"

comment "Sensor → HTTP uploader"
config ROUTE_SENSOR_LIGHT_HTTP
    bool "Upload LIGHT sensor JSON via HTTP"
    default y

config ROUTE_SENSOR_TEMP_HTTP
    bool "Upload TEMP&Humidity JSON via HTTP"
    default y

config ROUTE_JPEG_HTTP
    bool "Upload JPEG frame via HTTP"
    default y

comment "Sensor → HTTP sink"
config ROUTE_SENSOR_GROUP_HTTP
    bool "Forward all sensor topics to HTTP"
    default n

comment "Sensor → UART sink"
config ROUTE_SENSOR_GROUP_UART
    bool "Forward all sensor topics to UART"
    default y

comment "Sensor → BLE sink"
config ROUTE_SENSOR_GROUP_BLE
    bool "Forward all sensor topics to BLE notify"
    default y

endmenu  # Router

menu "Camera Settings"

config CAMERA_DYNAMIC_INTERVAL
    bool "Adjust capture interval based on Wi-Fi RSSI"
    default y
    help
        If enabled, the JPEG frame rate is chosen automatically
        according to the current Wi-Fi RSSI thresholds below.
        If disabled, the fixed interval CONFIG_CAMERA_CAPTURE_INTERVAL_MS
        is used.

config CAMERA_CAPTURE_INTERVAL_MS
    int "Fixed capture interval (ms)"
    range 100 60000
    default 5000
    depends on !CAMERA_DYNAMIC_INTERVAL

# ── Only visible when dynamic mode is ON ─────────────────────────────
if CAMERA_DYNAMIC_INTERVAL

config CAMERA_RSSI_FAST_THRESH
    int "Fast-FPS RSSI threshold (dBm)"
    default -60

config CAMERA_RSSI_MED_THRESH
    int "Medium-FPS RSSI threshold (dBm)"
    default -70

config CAMERA_INTERVAL_FAST_MS
    int "Interval when RSSI >= FAST_THRESH (ms)"
    range 100 1000
    default 333

config CAMERA_INTERVAL_MED_MS
    int "Interval when FAST_THRESH > RSSI >= MED_THRESH (ms)"
    range 200 5000
    default 1000

config CAMERA_INTERVAL_SLOW_MS
    int "Interval when RSSI < MED_THRESH (ms)"
    range 1000 60000
    default 5000

endif  # CAMERA_DYNAMIC_INTERVAL
endmenu  # Camera Settings


endmenu  # Service
```

## components/utils/Kconfig
```kconfig
# SPDX-License-Identifier: MIT
# Utils component — cache settings

menu "Monet Utils"

menu "Cache Settings"

config CACHE_MAX_ITEMS
    int "Maximum number of cache items"
    range 1 256
    default 32
    help
        Maximum number of elements the in-memory cache can hold
        before it starts overwriting old data.

config CACHE_ITEM_SIZE
    int "Cache item size (bytes)"
    range 16 512
    default 64
    help
        Size, in bytes, of each cache entry.  Keep this value
        aligned with the largest encoded sensor message length.

config CACHE_FLUSH_INTERVAL_MS
    int "Cache flush interval (ms)"
    range 100 60000
    default 5000
    help
        How often the cache is flushed to the next stage
        (e.g. persistent storage or network upload).

endmenu  # Cache Settings

endmenu  # Utils
```
